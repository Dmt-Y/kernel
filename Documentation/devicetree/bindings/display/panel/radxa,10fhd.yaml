## Documentation/devicetree/bindings/display/panel/radxa,10fhd.yaml
```yaml
# SPDX-License-Identifier: (GPL-2.0-only OR BSD-2-Clause)
%YAML 1.2
---
$id: http://devicetree.org/schemas/display/panel/radxa,10fhd.yaml#
$schema: http://devicetree.org/meta-schemas/core.yaml#

title: Radxa 10FHD MIPI DSI panel

maintainers:
  - Dmitry Yashin <dmt.yashin@gmail.com>

allOf:
  - $ref: panel-common.yaml#

properties:
  compatible:
    const: radxa,display-10fhd

  reg:
    maxItems: 1

  backlight: true
  reset-gpios: true

  vdd-supply:
    description: regulator that supplies the vdd voltage

  vccio-supply:
    description: regulator that supplies the vccio voltage

  rotation: true

  port: true

required:
  - compatible
  - reg
  - backlight
  - reset-gpios
  - vdd-supply
  - vccio-supply

additionalProperties: false

examples:
  - |
    dsi {
        #address-cells = <1>;
        #size-cells = <0>;
        panel@0 {
            compatible = "radxa,display-10fhd";
            reg = <0>;
            backlight = <&backlight>;
            pinctrl-names = "default";
            pinctrl-0 = <&lcd_reset>;
            reset-gpios = <&gpio2 RK_PC1 GPIO_ACTIVE_HIGH>;
            vccio-supply = <&vcc_1v8_s0>;
            vdd-supply = <&lcd_3v3>;

            port {
                panel_in_dsi1: endpoint {
                    remote-endpoint = <&dsi1_out_panel>;
                };
            };
        };
    };

...
```
